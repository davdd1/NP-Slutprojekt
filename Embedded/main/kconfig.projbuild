## Embedded/main/kconfig.projbuild
```kconfig
menu "MQTT"
    config MQTT_BROKER_URI
        string "MQTT Broker URI"
        default "192.168.0.14"
        help 
            "MQTT Broker URI, mqtts:// is prefixed to the URI"

    config MQTT_BROKER_PORT
        int "MQTT Broker Port"
        default 8884
        help 
            "MQTT Broker Port"
endmenu

menu "HTTPS"
    config HTTPS_SERVER_URI
        string "HTTPS Server URI"
        default "https://192.168.0.14:9191"
        help 
            "HTTPS Server URI, port included"
endmenu

menu "UART"
    config UART_BAUD_RATE
        int "UART Baud Rate"
        default 115200
        help 
            "UART Baud Rate"
endmenu

menu "WiFi"
    config WIFI_SSID
        string "WiFi SSID"
        default "MySSID"
        help 
            "WiFi SSID"

    config WIFI_PASSWORD
        string "WiFi Password"
        default "MyPassword"
        help 
            "WiFi Password"
endmenu
```
